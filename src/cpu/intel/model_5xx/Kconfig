## src/cpu/intel/model_61x/Kconfig
```kconfig
config CPU_INTEL_MODEL_61X
	bool
	select ARCH_X86
	select SUPPORT_CPU_UCODE_IN_CBFS
```

## src/mainboard/msi/ms5128/Kconfig
```kconfig
## SPDX-License-Identifier: GPL-2.0-only

if BOARD_MSI_5128 

config BOARD_SPECIFIC_OPTIONS
	def_bool y
	select ACPI_NO_CUSTOM_MADT
	select CPU_INTEL_P5
	select NORTHBRIDGE_INTEL_I430HX
	select SOUTHBRIDGE_INTEL_I82371SB
	select SUPERIO_WINBOND_W83877F
	select HAVE_PIRQ_TABLE
	select BOARD_ROMSIZE_KB_256
	select HAVE_OPTION_TABLE

config MAX_CPUS
	int
	default 1

config MAINBOARD_DIR
	default "msi/ms5128"

config MAINBOARD_PART_NUMBER
	default "MS-5128" if BOARD_MSI_5128

config VARIANT_DIR
	default "ms5128" if BOARD_MSI_5128

config OVERRIDE_DEVICETREE
	default "variants/\$(CONFIG_VARIANT_DIR)/overridetree.cb"

config IRQ_SLOT_COUNT
	int
	default 6

endif
```

## src/mainboard/msi/ms6117/Kconfig
```kconfig
## SPDX-License-Identifier: GPL-2.0-only

config BOARD_MSI_MS6117
	def_bool n
	select ACPI_NO_CUSTOM_MADT
	select CPU_INTEL_SLOT_1
	select NORTHBRIDGE_INTEL_I440LX
	select SOUTHBRIDGE_INTEL_I82371EB
	select SUPERIO_WINBOND_W83977TF
	select W83977TF_HAVE_SEPARATE_IR_DEVICE
	select BOARD_ROMSIZE_KB_256
	select HAVE_OPTION_TABLE
	select HAVE_CMOS_DEFAULT
	select HAVE_PIRQ_TABLE
	select HAVE_ACPI_TABLES
	select GENERATE_SMBIOS_TABLES
	select SDRAM_3DIMM_REVERSE_OFFSET

if BOARD_MSI_MS6117

config MAINBOARD_DIR
	default "msi/ms6117"

config MAINBOARD_PART_NUMBER
	default "MSI LX6 (MS-6117)" if BOARD_MSI_MS6117

config MAINBOARD_VENDOR
	default "Micro-Star International Co., Ltd."

config MAINBOARD_FAMILY
	default "Default string"

config IRQ_SLOT_COUNT
	int
	default 7 if BOARD_MSI_MS6117

config MAINBOARD_SMBIOS_PRODUCT_NAME
	default "MS-6117 (i440LX)"

config MAINBOARD_SMBIOS_MANUFACTURER
	string
	default "Micro-Star International Co., Ltd."

endif
```

## src/mainboard/pcchips/Kconfig
```kconfig
## SPDX-License-Identifier: GPL-2.0-only

if VENDOR_PCCHIPS

choice
	prompt "Mainboard model"

source "src/mainboard/pcchips/*/Kconfig.name"

endchoice

source "src/mainboard/pcchips/*/Kconfig"

config MAINBOARD_VENDOR
	default "PCChips"

endif # VENDOR_PCCHIPS
```

## src/mainboard/pcchips/m720/Kconfig
```kconfig
## SPDX-License-Identifier: GPL-2.0-only

if BOARD_PCCHIPS_M720 || BOARD_PCCHIPS_P2200 || BOARD_PCCHIPS_P2200_ACPI || BOARD_PCCHIPS_P2200_TINY

config BASE_PCCHIPS_M720
	def_bool n
	select SDRAMPWR_4DIMM
	select HAVE_MP_TABLE

config ROM_SIZE_TINY
	def_bool n
	select BOARD_ROMSIZE_KB_128

config ROM_SIZE_NORMAL
	def_bool n
	select BOARD_ROMSIZE_KB_256

config BOARD_SPECIFIC_OPTIONS
	def_bool y
	select ACPI_NO_CUSTOM_MADT
	select CPU_INTEL_SLOT_1
	select NORTHBRIDGE_INTEL_I440LX
	select SOUTHBRIDGE_INTEL_I82371EB
	select SUPERIO_ITE_IT8679F
	select HAVE_PIRQ_TABLE
	select ROM_SIZE_TINY if BOARD_PCCHIPS_P2200_TINY
	select ROM_SIZE_NORMAL if BOARD_PCCHIPS_M720 || BOARD_PCCHIPS_P2200 || BOARD_PCCHIPS_P2200_ACPI
	select HAVE_OPTION_TABLE
	select USE_OPTION_TABLE
	select SDRAMPWR_4DIMM if BOARD_PCCHIPS_M720 || BOARD_PCCHIPS_P2200
	select HAVE_ACPI_TABLES if BOARD_PCCHIPS_P2200_ACPI
	select BASE_PCCHIPS_M720 if BOARD_PCCHIPS_M720 || BOARD_PCCHIPS_P2200 || BOARD_PCCHIPS_P2200_TINY

config MAX_CPUS
	int
	default 2 if BOARD_PCCHIPS_M720 || BOARD_PCCHIPS_P2200 || BOARD_PCCHIPS_P2200_TINY

config MAINBOARD_DIR
	default "pcchips/m720"

config MAINBOARD_PART_NUMBER
	default "M720" if BOARD_PCCHIPS_M720
	default "P2200" if BOARD_PCCHIPS_P2200 || BOARD_PCCHIPS_P2200_TINY

config VARIANT_DIR
	default "m720" if BOARD_PCCHIPS_M720
	default "p2200" if BOARD_PCCHIPS_P2200 || BOARD_PCCHIPS_P2200_TINY

config OVERRIDE_DEVICETREE
	default "variants/\$(CONFIG_VARIANT_DIR)/overridetree.cb"

config IRQ_SLOT_COUNT
	int
	default 7 if BOARD_PCCHIPS_M720 || BOARD_PCCHIPS_P2200 || BOARD_PCCHIPS_P2200_TINY
	default 6

endif
```

## src/mainboard/shuttle/Kconfig
```kconfig
## SPDX-License-Identifier: GPL-2.0-only

if VENDOR_SHUTTLE

choice
	prompt "Mainboard model"

source "src/mainboard/shuttle/*/Kconfig.name"

endchoice

source "src/mainboard/shuttle/*/Kconfig"

config MAINBOARD_VENDOR
	default "Shuttle"

endif # VENDOR_SHUTTLE
```

## src/mainboard/shuttle/ab61/Kconfig
```kconfig
## SPDX-License-Identifier: GPL-2.0-only

if BOARD_SHUTTLE_AB61 || BOARD_SHUTTLE_HOT_661 || BOARD_SHUTTLE_HOT_649

config BASE_SHUTTLE_HOT_649
	def_bool n
	select SDRAMPWR_4DIMM
	select HAVE_MP_TABLE

config BOARD_SPECIFIC_OPTIONS
	def_bool y
	select ACPI_NO_CUSTOM_MADT
	select CPU_INTEL_SLOT_1
	select NORTHBRIDGE_INTEL_I440BX
	select SOUTHBRIDGE_INTEL_I82371EB
	select SUPERIO_WINBOND_W83977TF
	select HAVE_PIRQ_TABLE
	select BOARD_ROMSIZE_KB_256
	select HAVE_OPTION_TABLE
	select SDRAMPWR_4DIMM if BOARD_SHUTTLE_HOT_661 || BOARD_SHUTTLE_HOT_649
	select HAVE_ACPI_TABLES if BOARD_SHUTTLE_AB61 || BOARD_SHUTTLE_HOT_661
	select BASE_SHUTTLE_HOT_649 if BOARD_SHUTTLE_HOT_649

config MAX_CPUS
	int
	default 2 if BASE_SHUTTLE_HOT_649

config MAINBOARD_DIR
	default "shuttle/ab61"

config MAINBOARD_PART_NUMBER
	default "AB61" if BOARD_SHUTTLE_AB61
	default "HOT_661" if BOARD_SHUTTLE_HOT_661
	default "HOT_649" if BOARD_SHUTTLE_HOT_649

config VARIANT_DIR
	default "ab61" if BOARD_SHUTTLE_AB61
	default "hot-661" if BOARD_SHUTTLE_HOT_661
	default "hot-649" if BOARD_SHUTTLE_HOT_649

config OVERRIDE_DEVICETREE
	default "variants/\$(CONFIG_VARIANT_DIR)/overridetree.cb"

config IRQ_SLOT_COUNT
	int
	default 7 if BOARD_SHUTTLE_AB61
	default 6

endif
```

## src/mainboard/shuttle/ab61/Kconfig.name
```kconfig
config BOARD_SHUTTLE_AB61
	bool "AB61"

config BOARD_SHUTTLE_HOT_661
	bool "HOT661"

config BOARD_SHUTTLE_HOT_649
	bool "HOT649"
```
