## src/mainboard/pcchips/m720/Kconfig.name
```kconfig
config BOARD_PCCHIPS_M720
	bool "M720"

config BOARD_PCCHIPS_P2200
	bool "Amptron PII-2200 / P2200 (dual Slot 1)"

config BOARD_PCCHIPS_P2200_ACPI
	bool "P2200_ACPI"

config BOARD_PCCHIPS_P2200_TINY
	bool "P2200_TINY"
```

## src/northbridge/intel/i440lx/Kconfig
```kconfig
# SPDX-License-Identifier: GPL-2.0-only

config NORTHBRIDGE_INTEL_I440LX
	bool
	select NO_ECAM_MMCONF_SUPPORT
	select HAVE_DEBUG_RAM_SETUP
	select NO_CBFS_MCACHE

config I440LX_SPD_RAMINIT
	bool "Experimental SPD/CMOS SDRAM initialization"
	depends on NORTHBRIDGE_INTEL_I440LX
	select USE_SDR_SDRAM
	default n
	help
	  Replace the inherited BX geometry assumptions with an LX policy.
	  Validate complete 64-byte SPD snapshots, select common SDR timings,
	  detect ECC capability and retain compatible whole ranks within limits.
	  Manual CMOS timings remain constrained by SPD. No EDO/S3 support.

if I440LX_SPD_RAMINIT

config I440LX_SDRAM_CLOCK_PS
	int "Actual SDRAM clock period in picoseconds"
	default 15000
	range 15000 16667
	help
	  Board clock contract: 15000 for 66.67 MHz, 16667 for 60 MHz.
	  Does not program the PLL. PACCFG bit 14 is reserved in 297655-005.

config I440LX_SDRAM_MAX_TAC_PS
	int "Board-qualified maximum SDRAM clock-to-output time (ps)"
	default 9000
	range 1000 9000

config I440LX_SDRAM_FAST_MA
	bool "Board-qualified fast MA timing"
	default n
	help
	  Allow fast MA in Auto and Manual modes only after signal/timing tests.

config I440LX_SDRAM_MBSC
	hex "Board-qualified DRAM buffer strengths"
	default 0x00000000
	help
	  Retains the port's strong-drive baseline. Every two-bit field must
	  be 00, 01 or 10. Electrical loading is board-specific; no guessed
	  impedance formula is derived from SPD. Qualify each DIMM population.

config I440LX_ECC_WIRED
	bool "Board ECC wiring and initialization path verified"
	default n
	help
	  Allow CMOS EC/ECC after verifying all MECC wires and initialization
	  on this board. Detection works without this. Requires the P6 MMX
	  CAR path and full QWord initialization of all mapped DRAM.

config I440LX_RAM_ADDRESS_TEST
	bool "Check sampled rank address lines before using DRAM"
	default y

endif

config SDRAM_4DIMM
	bool
	depends on NORTHBRIDGE_INTEL_I440LX
	default n
	help
	  This option affects how the DRB and DRT register and is programmed.

	  If your board has 4 DIMM slots, you must select this option, in
	  your Kconfig file of the board. On boards with 3 DIMM slots,
	  do _not_ select this option.

config SDRAM_3DIMM
	bool
	depends on NORTHBRIDGE_INTEL_I440LX
	default n
	help
	  This option affects how the DRB and DRT register and is programmed.

	  If your board has 3 DIMM slots, and the SMBUS DIMM mapping
	  is not reversed you must select this option, in
	  your Kconfig file of the board. On boards with 4 DIMM slots,
	  do _not_ select this option.

config SDRAM_3DIMM_REVERSE_OFFSET
	bool
	depends on NORTHBRIDGE_INTEL_I440LX
	default n
	help
	This option is for very special (MSI) boards where the SMBUS SPD addresses
	are reverse associated with the DRAM Rows.

	If your board is an MSI 6117, ATC-6130 or otherwise feels special and
	has it's SMBUS address for Row (0,1) starting at 0x52
	and ending at Row (4,5) with address 0x50, you must pick this option.
config I440LX_MAB_SPD_ADDRESS
	hex "SPD address of the MAB-driven socket (three-DIMM boards)"
	depends on NORTHBRIDGE_INTEL_I440LX && !SDRAM_4DIMM
	default 0x50 if SDRAM_3DIMM_REVERSE_OFFSET
	default 0x52
	range 0x50 0x57
	help
	  Physical socket closest to PAC, driven by MAB. Required for the
	  x32/x8 loading check in Intel 297655-005 erratum 7. Verify against
	  the board's wiring; SPD cannot identify which MA copy drives a slot.

config I440LX_SMM
	bool "Experimental 440LX ASEG SMM (requires hardware validation)"
	depends on NORTHBRIDGE_INTEL_I440LX && SOUTHBRIDGE_INTEL_I82371EB && PARALLEL_MP
	depends on BOARD_MSI_MS6117 || BOARD_PCCHIPS_P2200 || BOARD_PCCHIPS_P2200_ACPI || BOARD_PCCHIPS_P2200_TINY
	depends on ARCH_RAMSTAGE_X86_32
	select SMM_LEGACY_ASEG
	select I82371EB_SMM
	default n
	help
	  Install a P6 legacy ASEG handler with separate CPU save areas/stacks.
	  Only APMC software SMIs and ACPI enable/disable are implemented.
	  No USB emulation, suspend/resume or Award power management is provided.
	  Keep disabled until tested on the particular CPU and board revision.
```

## src/southbridge/intel/i82371eb/Kconfig
```kconfig
config SOUTHBRIDGE_INTEL_I82371EB
	select ACPI_COMMON_MADT_IOAPIC if SMP
	select ACPI_COMMON_MADT_LAPIC if SMP
	select ACPI_NO_CUSTOM_MADT
	select ACPI_INTEL_HARDWARE_SLEEP_VALUES
	select SOUTHBRIDGE_INTEL_COMMON_SMBUS
	select SOUTHBRIDGE_INTEL_COMMON_RTC
	select SOUTHBRIDGE_INTEL_COMMON_RESET
	select BOOT_DEVICE_NOT_SPI_FLASH
	bool

# Selected only by an explicit, reviewed northbridge/board SMM adapter.
config I82371EB_SMM
	bool
	depends on SOUTHBRIDGE_INTEL_I82371EB && SMM_LEGACY_ASEG
	help
	  PIIX4 SMI services using the fixed E400 PM base. The enabled PM
	  and USB functions must have piix4_pm and piix4_usb device-tree
	  aliases. sconfig binds these at build time; there is no PCI scan.
	  The platform must quiesce events before relocation and signal that
	  SMRAM is locked before the post-device runtime probes can execute.
```
